/**
 * @cliArgs --board "/boards/LAUNCHXL_F28379D" --context "CPU1" --product "C2000WARE@5.00.00.00"
 * @versions {"tool":"1.19.0+3426"}
 */

/**
 * Import the modules used in this configuration.
 */
const led       = scripting.addModule("/driverlib/board_components/led", {}, false);
const led1      = led.addInstance();
const led2      = led.addInstance();
const cputimer  = scripting.addModule("/driverlib/cputimer.js", {}, false);
const cputimer1 = cputimer.addInstance();
const epwm      = scripting.addModule("/driverlib/epwm.js", {}, false);
const epwm1     = epwm.addInstance();
const sci       = scripting.addModule("/driverlib/sci.js", {}, false);
const sci1      = sci.addInstance();

/**
 * Write custom configuration values to the imported modules.
 */
led1.$name                  = "myBoardLED0";
led1.$hardware              = system.deviceData.board.components.LED4;
led1.gpio.writeInitialValue = true;
led1.gpio.initialValue      = 1;

led2.$name     = "myBoardLED1";
led2.$hardware = system.deviceData.board.components.LED5;

cputimer1.$name                    = "Led_Toggle_Timer";
cputimer1.enableInterrupt          = true;
cputimer1.registerInterrupts       = true;
cputimer1.startTimer               = true;
cputimer1.timerPeriod              = 200000000;
cputimer1.timerInt.enableInterrupt = true;

epwm1.$name                                = "modbus_timer";
epwm1.useCase                              = "CUSTOM";
epwm1.generateCodeTemplate                 = true;
epwm1.epwmTimebase_hsClockDiv              = "EPWM_HSCLOCK_DIVIDER_8";
epwm1.epwmTimebase_period                  = 25000;
epwm1.epwmEventTrigger_enableInterrupt     = true;
epwm1.epwmEventTrigger_interruptSource     = "EPWM_INT_TBCTR_PERIOD";
epwm1.epwmEventTrigger_interruptEventCount = "1";
epwm1.epwm.$assign                         = "EPWM10";

sci1.$name                 = "modbus_sci";
sci1.useInterrupts         = false;
sci1.baudRates             = 9600;
sci1.sci.$assign           = "SCIA";
sci1.sci.scirxdPin.$assign = "GPIO43";
sci1.sci.scitxdPin.$assign = "GPIO42";
scripting.suppress("Not pinned out,@@@.+?@@@ is not pinned out on the LaunchPad F28379D\\.  @@@.+?@@@", sci1.sci, "scirxdPin");
scripting.suppress("Not pinned out,@@@.+?@@@ is not pinned out on the LaunchPad F28379D\\.  @@@.+?@@@", sci1.sci, "scitxdPin");

/**
 * Pinmux solution for unlocked pins/peripherals. This ensures that minor changes to the automatic solver in a future
 * version of the tool will not impact the pinmux you originally saw.  These lines can be completely deleted in order to
 * re-solve from scratch.
 */
led1.gpio.gpioPin.$suggestSolution = "GPIO31";
led2.gpio.gpioPin.$suggestSolution = "GPIO34";
